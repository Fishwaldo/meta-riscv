## conf/machine/pinetabv.conf
```bitbake
#@TYPE: Machine
#@NAME: PineTabV
#@SOC: StarFive JH7110
#@DESCRIPTION: Machine configuration for the PineTabV board

require conf/machine/JH7110.inc

EXTRA_IMAGEDEPENDS:remove = "u-boot-starfive"

RISCV_SBI_FDT = "pine64_pinetabv.dtb"

KERNEL_DEVICETREE = "starfive/jh7110-pine64-pinetabv.dtb"

UBOOT_MACHINE = "pine64_pinetabv_defconfig"
UBOOT_DTB_BINARY = "pine64_pinetabv.dtb"

IMAGE_BOOT_FILES = " \
    fitImage-star64-image-initramfs-pinetabv-pinetabv;${KERNEL_IMAGETYPE} \
    uEnv.txt \
"

## wic default support
WKS_FILE_DEPENDS = " \
    e2fsprogs-native \
    bmap-tools-native \
"

WKS_FILE = "pinetabv.wks"
```

## wic/pinetabv.wks
```
# short-description: Create a bootable SD card/EMMC image for Pine64 PineTabv board
# long-description:
# Create a bootable image that can be written onto a SD card using dd for use
# with Pine64 PineTabv
#
# Factory u-boot expects the /boot partition to be at position 3, so create 2 empty partitions at the start of the Image
# PineTabV is not setup to load uboot from a SD Card, only SPI or UART, so we skip installing spl/u-boot
#
# The disk layout used is:
#  --------------- --------------
# |    boot      |    rootfs    |
#  --------------- --------------
# ^              ^
# |              |
# 0              300MiB + rootfs + IMAGE_EXTRA_SPACE
#
part emtpy1 --source empty --ondisk mmcblk --size="2048k" --label emtpy1
part empty2 --source empty --ondisk mmcblk --size="2048k" --label empty2
part /boot --source bootimg-partition --ondisk mmcblk --fstype=vfat --label boot --use-uuid --part-name boot --part-type EBD0A0A2-B9E5-4433-87C0-68B6B72699C7 --align 4096 --size 292M
part /root --source rootfs --ondisk mmcblk --fstype=ext4 --part-name root --part-type 0FC63DAF-8483-4772-8E79-3D69D8477DE4 --active --label root --align 4096
bootloader  --ptable gpt
```
